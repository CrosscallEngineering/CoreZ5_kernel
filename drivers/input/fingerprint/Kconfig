## drivers/input/fingerprint/Kconfig
```kconfig
config HS_FINGERPRINT
	tristate "fingerprint drvier support"
	help
	  Say Y here to enable fingerprint driver support!

config FINGERPRINT_SUNWAVE
	tristate "SUNWAVE SW9651 fingerprint drvier support"
	depends on HS_FINGERPRINT
	help
	  Say Y here to enable sunwave sw9651 driver support!

config FINGERPRINT_CHIPONE
	tristate "CHIPONE fingerprint driver support"
	depends on HS_FINGERPRINT
	help
	  Say Y here to enable CHIPONE Fingerpirnt driver support!

config FINGERPRINT_FPC_FPC1542
	tristate "FPC FPC1542 fingerprint drvier support"
	depends on HS_FINGERPRINT
	help
	  Say Y here to enable FPC FPC1542 driver support!
```

## drivers/input/touchscreen/chipone-tddi/Kconfig
```kconfig
#
# CHIPONE Touchscreen driver configuration
#

config TOUCHSCREEN_CHIPONE
	tristate "CHIPONE Touchscreen"
	help
	  Say Y here if you have CHIPONE touch panel.
	  If unsure, say N.
config TOUCHSCREEN_CHIPONE_GESTURE
       bool "chipone touchscreens gesture function"
       depends on TOUCHSCREEN_CHIPONE
       default n
       help
         Say Y here if you need a chipone touchscreen gesture function.
	 else say N

config TOUCHSCREEN_CHIPONE_GLOVE
       bool "chipone touchscreens glove function"
       depends on TOUCHSCREEN_CHIPONE
       default n
       help
         Say Y here if you need a chipone touchscreen glove function.
	 else say N
config TOUCHSCREEN_CHIPONE_INCELL_CHIP
       bool "Chipone incell touchscreens support."
       depends on TOUCHSCREEN_CHIPONE
       help
         Say Y here if you need a chipone incell touchscreen function.
	 else say N
config TOUCHSCREEN_CHIPONE_IN_QGKI
	bool "Chipone driver in QGKI"
	depends on TOUCHSCREEN_CHIPONE
	help
	  This enables support for Chipone driver test over Board.
```

## drivers/misc/checkfp/Kconfig
```kconfig
config FINGERPRINT_VENDOR_CHECK
	bool "fingerprint vendor check id pin"
	default n
	help
		this feature is for checking fingerprint vendor
```

## drivers/soc/hisense/base/Kconfig
```kconfig
comment "Hisense product Infomation"
config MACH_HISENSE_SMARTPHONE
	tristate "HISENSE SMARTPHONE"
	default n
	help
	  Support for the hisense samrtphone board.

config HISENSE_VENDOR_NAME
	depends on MACH_HISENSE_SMARTPHONE
	string "Hisense vendor info"
	default ""
	help
	  The vendor name of product.

config HISENSE_PRODUCT_NAME
	depends on MACH_HISENSE_SMARTPHONE
	string "Hisense product info"
	default ""
	help
	  The product name.

config HISENSE_DEBUG_CTRL
	bool "Hisense debug method"
	depends on MACH_HISENSE_SMARTPHONE
	default n
	help
	  Say Y when you need debug your device.

config HISENSE_BOOT_FLOW
	bool "Hisense boot flow"
	depends on MACH_HISENSE_SMARTPHONE
	default n
	help
	  Provide the special boot flow.
```

## drivers/soc/hisense/misc/Kconfig
```kconfig
config BEIDOU_GPS_CTRL
	bool "enable beidou gps chip"
	default n
	help
	  Say 'y' here to support BEIDOU chip
```

## drivers/soc/hisense/rs_recorder/Kconfig
```kconfig
config SUPPORT_WARM_RESET
	bool "current platform support warm reset"
	depends on RS_RECORDER_SUPPORT
	default n
	help
	  If use platform support warm reset, then say Y,
	  or N.
```
